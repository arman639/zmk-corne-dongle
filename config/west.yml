## config/west.yml
```yaml
manifest:
  remotes:
    - name: zmkfirmware
      url-base: https://github.com/zmkfirmware
    - name: gpeye
      url-base: https://github.com/GPeye
    - name: tokyo2006
      url-base: https://github.com/tokyo2006
    - name: englmaxi
      url-base: https://github.com/englmaxi
    - name: janpfischer
      url-base: https://github.com/janpfischer
    # - name: carrefinho
    #   url-base: https://github.com/carrefinho
  projects:
    - name: hammerbeam-slideshow
      remote: gpeye
      revision: main 
    - name: zmk
      remote: zmkfirmware
      revision: v0.3.0
      import: app/west.yml
    - name: prospector-zmk-module                 # <--- and these
      remote: tokyo2006                          # <---
      revision: 935ce92e1fff8cc1dc7b15354f8270af7cab0c07 # branch: change_spi2
    - name: zmk-dongle-display
      remote: englmaxi
      revision: v0.3
    - name: zmk-dongle-screen
      remote: janpfischer
      revision: main
    # - name: prospector
    #   remote: carrefinho
    #   revision: main
  self:
    path: config
```
